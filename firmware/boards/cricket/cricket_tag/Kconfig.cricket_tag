## firmware/boards/cricket/cricket_tag/Kconfig.cricket_tag
```kconfig
# SPDX-License-Identifier: MIT

config BOARD_CRICKET_TAG
	select SOC_NRF54L15_CPUAPP if BOARD_CRICKET_TAG_NRF54L15_CPUAPP
```

## firmware/boards/cricket/cricket_tag/Kconfig.defconfig
```kconfig
# SPDX-License-Identifier: MIT

if BOARD_CRICKET_TAG

config HW_STACK_PROTECTION
	default ARCH_HAS_STACK_PROTECTION

endif # BOARD_CRICKET_TAG
```

## firmware/boards/cricket/cricket_tag/board.yml
```yaml
board:
  name: cricket_tag
  full_name: Cricket tag (Insight SiP ISP2454-LX)
  socs:
    - name: nrf54l15
runners:
  run_once:
    '--recover':
      - runners:
          - nrfjprog
          - nrfutil
        run: first
        groups:
          - boards:
              - cricket_tag/nrf54l15/cpuapp
    '--erase':
      - runners:
          - nrfjprog
          - jlink
          - nrfutil
        run: first
        groups:
          - boards:
              - cricket_tag/nrf54l15/cpuapp
    '--reset':
      - runners:
          - nrfjprog
          - jlink
          - nrfutil
        run: last
        groups:
          - boards:
              - cricket_tag/nrf54l15/cpuapp
```
